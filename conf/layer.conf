## conf/layer.conf
```bitbake
# We have a conf and classes directory, add to BBPATH
BBPATH .= ":${LAYERDIR}"

# We have recipes-* directories, add to BBFILES
BBFILES += "${LAYERDIR}/recipes-*/*/*.bb \
            ${LAYERDIR}/recipes-*/*/*.bbappend"

BBFILE_COLLECTIONS += "meta-patch_1.0"
BBFILE_PATTERN_meta-patch_1.0 = "^${LAYERDIR}/"
BBFILE_PRIORITY_meta-patch_1.0 = "6"

LAYERDEPENDS_meta-patch_1.0 = "core"
LAYERSERIES_COMPAT_meta-patch_1.0 = "honister"
```
